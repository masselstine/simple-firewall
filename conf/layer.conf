## conf/layer.conf
```bitbake
# We have a conf and classes directory, add to BBPATH
BBPATH .= ":${LAYERDIR}"

# We have recipes-* directories, add to BBFILES
BBFILES += "${LAYERDIR}/recipes-*/*/*.bb \
            ${LAYERDIR}/recipes-*/*/*.bbappend"

BBFILE_COLLECTIONS += "/home/masselst/builds/overc/layers/simple-firewall"
BBFILE_PATTERN_/home/masselst/builds/overc/layers/simple-firewall = "^${LAYERDIR}/"
BBFILE_PRIORITY_/home/masselst/builds/overc/layers/simple-firewall = "6"

LAYERDEPENDS_/home/masselst/builds/overc/layers/simple-firewall = "core"
LAYERSERIES_COMPAT_/home/masselst/builds/overc/layers/simple-firewall = "sumo"
```
